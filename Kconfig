## Kconfig
```kconfig
# Kconfig - LinkedSemi EC FW (Leo / LS101x)
# SPDX-License-Identifier: Apache-2.0

mainmenu "LinkedSemi Embedded Controller firmware"

rsource "app/peripheral_management/Kconfig"
rsource "app/debug/Kconfig"
rsource "app/power_sequencing/Kconfig"
rsource "app/smchost/Kconfig"
rsource "app/kbchost/Kconfig"
rsource "app/thermal_management/Kconfig"

menu "EC optional features"

rsource "app/power_management/Kconfig"
rsource "app/soc_debug_awareness/Kconfig"
rsource "boards/Kconfig"

config LS_ECFW_POC_SIM_PWRSEQ
	bool "Simulate power sequencing without full RVP GPIOs"
	default y
	help
	  Log-step power sequence when board power GPIOs are stubs on EVB.

config LS_ECFW_RELAXED_DEVICE_CHECK
	bool "Do not fail boot if some DT devices are not ready"
	default y
	help
	  EVB may enable peripherals not needed by EC PoC.

endmenu

menu "EC logging control"

config EC_DEBUG_LOG
	bool "Embedded controller logs"
	depends on LOG
	default y

config EC_LOG_LEVEL
	int "Embedded controller application log level"
	depends on LOG
	default 3 if EC_DEBUG_LOG
	default 0

config BOARD_LOG_LEVEL
	int "Board initialization log level"
	depends on LOG
	default 3 if EC_DEBUG_LOG
	default 0

config EC_DELAYED_BOOT
	int "Delayed boot in seconds"
	default 0

endmenu

rsource "drivers/Kconfig"

source "Kconfig.zephyr"
```

## boards/Kconfig
```kconfig
# Kconfig - board options for LinkedSemi EC
# SPDX-License-Identifier: Apache-2.0

menu "Optional board features"

config BOARD_ID_IO_EXPANDER
	bool "IO Expander used for generating board ID"
	default n
	help
	  Indicates if board ID is generated making use of an IO Expander.

config ATX_SUPPORT
	bool "ATX power supply detection"
	help
	  Indicate if EC handles detection of ATX power supply.

endmenu
```

## boards/linkedsemi/ls101x_ehl_tcp_3l/Kconfig.defconfig
```kconfig
# Copyright (c) 2026 LinkedSemi
# SPDX-License-Identifier: Apache-2.0

if BOARD_LS101X_EHL_TCP_3L

config BOARD
	default "ls101x_ehl_tcp_3l"

config FLASH_LOAD_OFFSET
	default 0x0

config HEAP_MEM_POOL_SIZE
	default 4096

endif
```

## boards/linkedsemi/ls101x_ehl_tcp_3l/Kconfig.ls101x_ehl_tcp_3l
```kconfig
# Copyright (c) 2026 LinkedSemi
# SPDX-License-Identifier: Apache-2.0

config BOARD_LS101X_EHL_TCP_3L
	select SOC_LS1010
```

## boards/linkedsemi/ls101x_ehl_tcp_3l/ls101x_ehl_tcp_3l_defconfig
```kconfig
# Copyright (c) 2026 LinkedSemi
# SPDX-License-Identifier: Apache-2.0

CONFIG_OUTPUT_DISASSEMBLY=y
CONFIG_NEWLIB_LIBC=y
CONFIG_MAIN_STACK_SIZE=2048
CONFIG_ISR_STACK_SIZE=4096

CONFIG_PINCTRL=y
CONFIG_GPIO=y

CONFIG_SERIAL=y
CONFIG_CONSOLE=y
CONFIG_UART_CONSOLE=y

CONFIG_CLOCK_CONTROL=y

CONFIG_ESPI=y
CONFIG_ASSERT=y
CONFIG_KCS=y
```

## west.yml
```yaml
# West manifest for LinkedSemi EC firmware (Leo / LS101x)
# SPDX-License-Identifier: Apache-2.0

manifest:
  remotes:
    - name: linkedsemi
      url-base: https://github.com/linkedsemi

  defaults:
    remote: linkedsemi

  projects:
    - name: zephyr
      revision: linkedsemi
      path: zephyr
      west-commands: scripts/west-commands.yml

    - name: ls_sdk
      revision: main
      path: ls_sdk

  self:
    path: my_ecfw_zephyr
```
